// SPDX-License-Identifier: (GPL-2.0 OR MIT)

&partitions {
	partition@580000 {
		label = "ubi";
		reg = <0x580000 0x7200000>;
	};
};

&spi_nand {
	mediatek,nmbm;
	mediatek,bmt-max-ratio = <1>;
	mediatek,bmt-max-reserved-blocks = <64>;
};
